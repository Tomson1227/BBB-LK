/dts-v1/;
/plugin/;

#include <dt-bindings/gpio/gpio.h>

/ {
	compatible = "ti,beaglebone", "ti,beaglebone-black";

	fragment@0 {
		target = <&gpio1>;
		__overlay__ {
			stepper: stepper {
				compatible = "stepper";
				pins = <47 27>;
			};
		};
	};
};
