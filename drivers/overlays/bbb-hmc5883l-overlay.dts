/dts-v1/;
/plugin/;

/ {
    compatible = "ti,beaglebone", "ti,beaglebone-black";

    fragment@0 {
        target = <&i2c2>;
        __overlay__{
            status = "okay";
			#address-cells = <1>;
            #size-cells = <0>;
            	hmc5883l: hmc5883l@1e {
				compatible = "hmc5883l";
				reg = <0x1e>;
			};
        };
    };
};
